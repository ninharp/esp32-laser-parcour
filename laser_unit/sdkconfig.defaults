## laser_unit/sdkconfig.defaults
```kconfig
# ESP32-C3 Configuration
CONFIG_IDF_TARGET="esp32c3"

# Serial flasher config
CONFIG_ESPTOOLPY_FLASHSIZE_4MB=y
CONFIG_ESPTOOLPY_FLASHMODE_QIO=y
CONFIG_ESPTOOLPY_FLASHFREQ_80M=y

# Partition Table
CONFIG_PARTITION_TABLE_SINGLE_APP=y

# Compiler options
CONFIG_COMPILER_OPTIMIZATION_SIZE=y

# Component config
CONFIG_FREERTOS_HZ=1000

# ESP32C3-Specific
CONFIG_ESP32C3_DEFAULT_CPU_FREQ_160=y

# Bootloader config
CONFIG_BOOTLOADER_LOG_LEVEL_INFO=y

# Log output
CONFIG_LOG_DEFAULT_LEVEL_INFO=y
```

## main/Kconfig.projbuild
```kconfig
menu "Laser Parcour Configuration"

    choice MODULE_ROLE
        prompt "Module Role"
        default MODULE_ROLE_CONTROL
        help
            Select the role of this module in the laser parcour system.

        config MODULE_ROLE_CONTROL
            bool "Main Unit"
            help
                Central game controller managing game state and coordination.
                Runs web server and OLED display.

        config MODULE_ROLE_LASER
            bool "Laser Unit"
            help
                Combined laser emitter and sensor unit that controls laser diode
                and detects beam interruptions.

        config MODULE_ROLE_FINISH
            bool "Finish Button"
            help
                Finish line button device that marks successful game completion.
                Sends MSG_FINISH_PRESSED when button is pressed.
    endchoice

    config MODULE_ID
        int "Module ID"
        range 1 255
        default 1
        help
            Unique identifier for this module (1-255).
            Main Unit typically uses ID 1.
            Laser Units use IDs 2-20.
            
            Note: If migrating from a previous version where sensors and lasers
            were separate, you may need to reconfigure module IDs.

    config DEVICE_NAME
        string "Device Name"
        default "ESP32-LaserModule"
        help
            Custom name for this device (shown in web interface).

    menu "Network Settings"

        config WIFI_SSID
            string "WiFi SSID"
            default "ESP32-LaserParcour"
            help
                SSID for WiFi Access Point (Control module only).

        config WIFI_PASSWORD
            string "WiFi Password"
            default "lasergame"
            help
                Password for WiFi Access Point (minimum 8 characters).

        config WIFI_CHANNEL
            int "WiFi Channel"
            range 1 13
            default 1
            help
                WiFi channel for both AP and ESP-NOW (must match on all modules).

        config MAX_STA_CONN
            int "Maximum Simultaneous Connections"
            range 1 4
            default 4
            help
                Maximum number of stations that can connect to AP.

        config ESPNOW_CHANNEL
            int "ESP-NOW Channel"
            range 1 13
            default 1
            help
                Channel for ESP-NOW communication (must match WiFi channel).

        config MAX_ESPNOW_PEERS
            int "Maximum ESP-NOW Peers"
            range 1 20
            default 20
            help
                Maximum number of ESP-NOW peers (connected modules).

    endmenu

    menu "Game Parameters"

        config GAME_DURATION
            int "Default Game Duration (seconds)"
            range 30 600
            default 180
            help
                Default game duration in seconds (3 minutes = 180).

        config PENALTY_TIME
            int "Beam Break Penalty (seconds)"
            range 0 30
            default 5
            help
                Time penalty in seconds for each beam break.

        config COUNTDOWN_DURATION
            int "Pre-Game Countdown (seconds)"
            range 3 10
            default 5
            help
                Countdown duration before game starts.

    endmenu

    menu "Hardware Configuration"

        config ENABLE_DISPLAY
            bool "Enable OLED Display"
            default y
            depends on MODULE_ROLE_CONTROL
            help
                Enable OLED display support. Disable this if running headless
                with web interface only.

        choice OLED_TYPE
            prompt "OLED Display Type"
            default OLED_SSD1306
            depends on MODULE_ROLE_CONTROL && ENABLE_DISPLAY
            help
                Type of OLED display controller.

            config OLED_SSD1306
                bool "SSD1306"
            config OLED_SH1106
                bool "SH1106"
        endchoice

        config I2C_SDA_PIN
            int "I2C SDA Pin"
            range -1 21
            default 19
            depends on MODULE_ROLE_CONTROL && ENABLE_DISPLAY
            help
                GPIO pin for I2C data line (SDA).
                Set to -1 to disable display.
                Note: GPIO18-19 are used for USB on some boards.
                Recommended: GPIO0-10, GPIO20-21.

        config I2C_SCL_PIN
            int "I2C SCL Pin"
            range -1 21
            default 18
            depends on MODULE_ROLE_CONTROL && ENABLE_DISPLAY
            help
                GPIO pin for I2C clock line (SCL).
                Set to -1 to disable display.
                Note: GPIO18-19 are used for USB on some boards.
                Recommended: GPIO0-10, GPIO20-21.

        config I2C_FREQUENCY
            int "I2C Frequency (Hz)"
            range 100000 400000
            default 100000
            depends on MODULE_ROLE_CONTROL && ENABLE_DISPLAY
            help
                I2C bus frequency in Hz (100kHz or 400kHz).

        config DISPLAY_ROTATION_180
            bool "Rotate Display 180 Degrees"
            default y
            depends on MODULE_ROLE_CONTROL && ENABLE_DISPLAY
            help
                Rotate the OLED display by 180 degrees.
                Enable this if your display is mounted upside-down.

        config ENABLE_BUTTONS
            bool "Enable Physical Buttons"
            default y
            depends on MODULE_ROLE_CONTROL
            help
                Enable physical button support. Disable this if controlling
                only via web interface.

        config BUTTON1_PIN
            int "Button 1 Pin (Start/Stop)"
            range -1 21
            default 10
            depends on MODULE_ROLE_CONTROL && ENABLE_BUTTONS
            help
                GPIO pin for Button 1 (Start/Stop/Resume game).
                - Short press: Start game (IDLE) / Stop game (RUNNING) / Resume game (PAUSED)
                - Long press: Toggle all laser units ON/OFF
                Set to -1 to disable this button.

        config BUTTON2_PIN
            int "Button 2 Pin (Stop/Reset)"
            range -1 21
            default 3
            depends on MODULE_ROLE_CONTROL && ENABLE_BUTTONS
            help
                GPIO pin for Button 2 (Stop running game).
                - Immediately stops and resets active game
                Set to -1 to disable this button.

        config BUTTON3_PIN
            int "Button 3 Pin (Debug Finish)"
            range -1 21
            default 2
            depends on MODULE_ROLE_CONTROL && ENABLE_BUTTONS
            help
                GPIO pin for Button 3 (Debug Finish Button).
                Can be used to trigger game finish without walking to the finish line.
                Enable/disable this function with CONFIG_ENABLE_BUTTON3_DEBUG_FINISH.
                Set to -1 to disable this button.

        config ENABLE_BUTTON3_DEBUG_FINISH
            bool "Enable Button 3 as Debug Finish Button"
            default y
            depends on MODULE_ROLE_CONTROL && ENABLE_BUTTONS
            help
                When enabled, Button 3 acts as a debug finish button.
                Pressing it during an active game will trigger game_finish(),
                simulating a successful parcour completion.
                
                This is useful for testing without having to walk to the
                actual finish button at the end of the parcour.
                
                Disable this in production to prevent accidental game completion.

        config ENABLE_BUZZER
            bool "Enable Buzzer"
            default n
            depends on MODULE_ROLE_CONTROL
            help
                Enable buzzer/speaker for audio feedback.

        config BUZZER_PIN
            int "Buzzer Pin"
            range -1 21
            default 5
            depends on MODULE_ROLE_CONTROL && ENABLE_BUZZER
            help
                GPIO pin for buzzer/speaker output.
                Set to -1 to disable buzzer.

        config LASER_PIN
            int "Laser Control Pin"
            range 0 21
            default 2
            depends on MODULE_ROLE_LASER
            help
                GPIO pin for laser diode control (PWM capable).

        config LASER_STATUS_LED_PIN
            int "Laser Status LED Pin"
            range 0 21
            default 21
            depends on MODULE_ROLE_LASER
            help
                GPIO pin for status LED on laser unit.

        config SENSOR_PIN
            int "Photoresistor ADC Pin"
            range 0 4
            default 4
            depends on MODULE_ROLE_LASER
            help
                ADC channel for photoresistor (GPIO0-4 = ADC1_CH0-4).
                The sensor is integrated in the laser unit.

        config SENSOR_LED_GREEN_PIN
            int "Sensor Green LED Pin"
            range 0 21
            default 20
            depends on MODULE_ROLE_LASER
            help
                GPIO pin for green status LED (beam detected).

        config SENSOR_LED_RED_PIN
            int "Sensor Red LED Pin"
            range 0 21
            default 10
            depends on MODULE_ROLE_LASER
            help
                GPIO pin for red status LED (beam broken).

        config FINISH_BUTTON_PIN
            int "Finish Button GPIO Pin"
            range 0 21
            default 5
            depends on MODULE_ROLE_FINISH
            help
                GPIO pin for finish button input (active low with internal pull-up).
                Pressing this button sends MSG_FINISH_PRESSED to complete the game.

        config FINISH_STATUS_LED_PIN
            int "Finish Button Status LED Pin"
            range 0 21
            default 6
            depends on MODULE_ROLE_FINISH
            help
                GPIO pin for status LED indicating connection/pairing status.
                LED blinks when not paired, solid when paired.

        config FINISH_BUTTON_LED_PIN
            int "Finish Button Illumination LED Pin"
            range 0 21
            default 7
            depends on MODULE_ROLE_FINISH
            help
                GPIO pin for button illumination LED.
                This LED turns OFF when button is pressed to provide visual feedback.

        config SENSOR_THRESHOLD
            int "Beam Detection Threshold"
            range 0 4095
            default 2000
            depends on MODULE_ROLE_LASER
            help
                ADC threshold for detecting beam break (0-4095, 12-bit ADC).
                For LDR with laser: Set between no-laser value (~850) and laser value (~4095).
                Recommended: 2000. ADC above threshold = beam present, below = beam broken.

        config DEBOUNCE_TIME
            int "Debounce Time (ms)"
            range 10 1000
            default 100
            help
                Debounce delay in milliseconds for buttons and sensors.

    endmenu

    menu "SD Card Configuration"
        depends on MODULE_ROLE_CONTROL

        config ENABLE_SD_CARD
            bool "Enable SD Card Support"
            default y
            help
                Enable SD Card support via SPI interface.
                
                When enabled and SD card is present with /web directory:
                - Web interface files will be served from /sdcard/web/
                - Allows custom web interface without reflashing firmware
                
                Fallback to internal web interface if:
                - SD card initialization fails
                - /web directory not found
                
                SD card remains mounted for other uses (e.g., logging, sound files).

        config SD_CARD_MOSI_PIN
            int "SD Card MOSI Pin (SPI)"
            range 0 21
            default 7
            depends on ENABLE_SD_CARD
            help
                GPIO pin for SPI MOSI (Master Out Slave In) signal.
                Connect to SD card's DI (Data In) pin.

        config SD_CARD_MISO_PIN
            int "SD Card MISO Pin (SPI)"
            range 0 21
            default 5
            depends on ENABLE_SD_CARD
            help
                GPIO pin for SPI MISO (Master In Slave Out) signal.
                Connect to SD card's DO (Data Out) pin.

        config SD_CARD_CLK_PIN
            int "SD Card CLK Pin (SPI)"
            range 0 21
            default 6
            depends on ENABLE_SD_CARD
            help
                GPIO pin for SPI CLK (Clock) signal.
                Connect to SD card's CLK pin.

        config SD_CARD_CS_PIN
            int "SD Card CS Pin (SPI)"
            range 0 21
            default 8
            depends on ENABLE_SD_CARD
            help
                GPIO pin for SPI CS (Chip Select) signal.
                Connect to SD card's CS pin.

    endmenu

    menu "Sound Manager (I2S Audio)"
        depends on MODULE_ROLE_CONTROL

        config ENABLE_SOUND_MANAGER
            bool "Enable Sound Manager (I2S Audio)"
            default n
            help
                Enable I2S sound manager for playing WAV/MP3 files from SD card.
                Requires ESP-ADF and SD card support.
                
                When enabled, sounds will be played via I2S audio module instead of buzzer.
                Falls back to buzzer if sound file not found or I2S initialization fails.

        config I2S_BCK_PIN
            int "I2S BCK (Bit Clock) Pin"
            range 0 21
            default 4
            depends on ENABLE_SOUND_MANAGER
            help
                GPIO pin for I2S bit clock (BCK/BCLK).
                Connects to the I2S audio module's BCK pin.

        config I2S_WS_PIN
            int "I2S WS (Word Select) Pin"
            range 0 21
            default 5
            depends on ENABLE_SOUND_MANAGER
            help
                GPIO pin for I2S word select (WS/LRCLK).
                Connects to the I2S audio module's LRC/WS pin.

        config I2S_DATA_OUT_PIN
            int "I2S Data Out Pin"
            range 0 21
            default 6
            depends on ENABLE_SOUND_MANAGER
            help
                GPIO pin for I2S data output (DOUT).
                Connects to the I2S audio module's DIN pin.

        config SOUND_FILES_PATH
            string "Sound Files Directory"
            default "/sdcard/sounds"
            depends on ENABLE_SOUND_MANAGER
            help
                Path to directory containing sound files on SD card.
                Sound files should be in WAV or MP3 format.

        config DEFAULT_VOLUME
            int "Default Volume (%)"
            range 0 100
            default 70
            depends on ENABLE_SOUND_MANAGER
            help
                Default volume level (0-100%).

    endmenu

endmenu
```
